#include <behaviors.dtsi>
#include <dt-bindings/zmk/keys.h>

/ {
    behaviors {

        td0: tap_dance_0 {
            compatible = "zmk,behavior-tap-dance";
            label = "punctuation";
            #binding-cells = <0>;
            tapping-term-ms = <300>;
            bindings = <&kp COMMA>, <&kp SEMI>, <&kp COLON>;  // , ; :
        };

        td1: tap_dance_1 {
            compatible = "zmk,behavior-tap-dance";
            label = "punctuation2";
            #binding-cells = <0>;
            tapping-term-ms = <300>;
            bindings = <&kp DOT>, <&kp SQT>, <&kp DQT>; // Period ' "
        };


    };
};